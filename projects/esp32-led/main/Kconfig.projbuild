## projects/esp32-led/main/Kconfig.projbuild
```kconfig
menu "Vibe Light LED"

config VIBE_LED_RED_GPIO
    int "Red LED GPIO"
    range 0 48
    default 4

config VIBE_LED_YELLOW_GPIO
    int "Yellow LED GPIO"
    range 0 48
    default 5

config VIBE_LED_GREEN_GPIO
    int "Green LED GPIO"
    range 0 48
    default 6

config VIBE_LED_CODEX_7D_RED_THRESHOLD_PERCENT
    int "Fallback Codex 7D red threshold percent"
    range 0 100
    default 10

config VIBE_LED_SUCCESS_HOLD_SECONDS
    int "Completed task green hold in seconds"
    range 1 3600
    default 60

config VIBE_LED_STARTUP_SELF_TEST
    bool "Run red-yellow-green startup self-test"
    default y

endmenu
```

## projects/esp32-led/sdkconfig.defaults
```kconfig
CONFIG_IDF_TARGET="esp32s3"
CONFIG_ESPTOOLPY_FLASHSIZE_16MB=y
CONFIG_BOOTLOADER_APP_ROLLBACK_ENABLE=y
CONFIG_PARTITION_TABLE_CUSTOM=y
CONFIG_PARTITION_TABLE_CUSTOM_FILENAME="../esp32-common/partitions_ota_16mb.csv"
CONFIG_PARTITION_TABLE_FILENAME="../esp32-common/partitions_ota_16mb.csv"
CONFIG_BT_ENABLED=y
CONFIG_BT_BLE_ENABLED=y
CONFIG_BT_NIMBLE_ENABLED=y
CONFIG_BT_CONTROLLER_ENABLED=y
CONFIG_BT_NIMBLE_ROLE_PERIPHERAL=y
CONFIG_BT_NIMBLE_MAX_CONNECTIONS=1
CONFIG_BT_NIMBLE_ATT_PREFERRED_MTU=517
CONFIG_BT_NIMBLE_HOST_TASK_STACK_SIZE=8192
CONFIG_ESP_MAIN_TASK_STACK_SIZE=4096
```
